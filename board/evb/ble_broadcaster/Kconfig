## board/evb/ble_broadcaster/Kconfig
```kconfig
config REALTEK_APP_BLE_BROADCASTER
   bool 
   default y

rsource "../../../Kconfig"
```

## board/evb/ble_central/Kconfig
```kconfig
config REALTEK_APP_BLE_CENTRAL
   bool 
   default y

rsource "../../../Kconfig"
```

## board/evb/ble_observer/Kconfig
```kconfig
config REALTEK_APP_BLE_OBSERVER
   bool 
   default y

rsource "../../../Kconfig"
```

## board/evb/ble_peripheral/Kconfig
```kconfig
config REALTEK_APP_BLE_PERIPHERAL 
   bool 
   default y

rsource "../../../Kconfig"
```

## board/evb/ble_scatternet/Kconfig
```kconfig
config REALTEK_APP_BLE_SCATTERNET
   bool 
   default y

rsource "../../../Kconfig"
```

## board/evb/framework/Kconfig.console
```kconfig
if REALTEK_CONSOLE

config REALTEK_CONSOLE_TARGET_NAME
   string
   default "libconsole"

endif
```

## board/evb/framework/Kconfig.framework
```kconfig
if REALTEK_FRAMEWORK

choice REALTEK_FRAMEWORK_TARGET
    prompt "target"
	default REALTEK_FRAMEWORK_TARGET_DEFAULT

config  REALTEK_FRAMEWORK_TARGET_DEFAULT
    bool "default"

	help
	  build framework library target name for default

if REALTEK_FRAMEWORK_TARGET_DEFAULT
config REALTEK_FRAMEWORK_TARGET_NAME
    string
	default "libframework_default"
endif

config  REALTEK_FRAMEWORK_TARGET_ALL
    bool "all"
	help
	  build framework library target name for all

if REALTEK_FRAMEWORK_TARGET_ALL
config REALTEK_FRAMEWORK_TARGET_NAME
    string
	default "libframework_all"
endif

config  REALTEK_FRAMEWORK_TARGET_DURIAN
    bool "durian"
	help
	  build framework library target name for durian

if REALTEK_FRAMEWORK_TARGET_DURIAN
config REALTEK_FRAMEWORK_TARGET_NAME
    string
	default "libframework_durian"
endif

config  REALTEK_FRAMEWORK_TARGET_STEREO
    bool "stereo"
	help
	  build framework library target name for stereo

if REALTEK_FRAMEWORK_TARGET_STEREO
config REALTEK_FRAMEWORK_TARGET_NAME
    string
	default "libframework_stereo"
endif

config  REALTEK_FRAMEWORK_TARGET_WATCH
    bool "watch"
	help
	  build framework library target name for watch

if REALTEK_FRAMEWORK_TARGET_WATCH
config REALTEK_FRAMEWORK_TARGET_NAME
    string
	default "libframework_watch"
endif

endchoice


config REALTEK_BTM_HID_SUPPORT
   bool "BTM HID SUPPORT"
   default y
   help
     BTM HID SUPPORT

config REALTEK_BTM_IAP_SUPPORT
   bool "BTM IAP SUPPORT"
   default y
   help
     BTM IAP SUPPORT

config REALTEK_BTM_MAP_SUPPORT
   bool "BTM MAP SUPPORT"
   default y
   help
     BTM MAP SUPPORT

config REALTEK_BTM_ROLESWAP_SUPPORT
   bool "BTM ROLESWAP SUPPORT"
   default y
   help
     BTM ROLESWAP SUPPORT

config REALTEK_BTM_PBAP_SUPPORT
   bool "BTM PBAP SUPPORT"
   default y
   help
     BTM PBAP SUPPORT

config REALTEK_BTM_ATT_SUPPORT
   bool "BTM ATT SUPPORT"
   default y
   help
     BTM ATT SUPPORT

config REALTEK_BTM_AVRCP_BROWSING_SUPPORT
   bool "BTM AVRCP BROWSING SUPPORT"
   default y
   help
     BTM AVRCP BROWSING SUPPORT

config REALTEK_BTM_AVRCP_COVER_ART_SUPPORT
   bool "BTM AVRCP COVER ART SUPPORT"
   default y
   help
     BTM AVRCP COVER ART SUPPORT

config REALTEK_BTM_HFP_AG_SUPPORT
   bool "BTM HFP AG SUPPORT"
   default y
   help
     BTM HFP AG SUPPORT

config REALTEK_AM_LINE_IN_SUPPORT
   bool "AM LINE IN SUPPORT"
   default y
   help
     AM LINE IN SUPPORT

config REALTEK_AM_AUDIO_PIPE_SUPPORT
   bool "AM AUDIO PIPE SUPPORT"
   default y
   help
     AM AUDIO PIPE SUPPORT

config REALTEK_LISTEN_WHILE_SAVE_SUPPORT
   bool "LISTEN WHILE SAVE SUPPORT"
   default y
   help
     LISTEN WHILE SAVE SUPPORT

config REALTEK_AM_ANC_SUPPORT
   bool "AM ANC SUPPORT"
   default y
   help
     AM ANC SUPPORT

config REALTEK_AM_AUDIO_PLUGIN_SUPPORT
   bool "AM AUDIO PLUGIN SUPPORT"
   default y
   help
     AM AUDIO PLUGIN SUPPORT

config REALTEK_AM_AUDIO_STEREO_SUPPORT
   bool "AM AUDIO STEREO SUPPORT"
   default n
   help
     AM AUDIO STEREO SUPPORT

config REALTEK_BTM_AVP_SUPPORT
   bool "BTM AVP SUPPORT"
   default n
   help
     BTM AVP SUPPORT

config REALTEK_BTM_AVRCP_TG_SUPPORT
   bool "BTM AVRCP TG SUPPORT"
   default n
   help
     BTM AVRCP TG SUPPORT

config REALTEK_REMOTE_CONTROL_SUPPORT
   bool "remote control support"
   default y
   help
     REMOTE_CONTROL_SUPPORT

endif
```

## board/evb/framework/Kconfig.remote
```kconfig
if REALTEK_REMOTE

config REALTEK_REMOTE_TARGET_NAME
   string
   default "libremote"

config REALTEK_REMOTE_CONTROL_SUPPORT
   bool "remote control support"
   default y
   help
     REMOTE_CONTROL_SUPPORT

endif
```

## board/evb/framework/Kconfig.sysm
```kconfig
if REALTEK_SYSM

config REALTEK_SYSM_TARGET_NAME
   string
   default "libsysm"

endif
```

## board/evb/io_demo/Kconfig
```kconfig
mainmenu "realtek iodemo mainmenu"

menu "iodemo"
rsource "../../../src/Kconfig"
endmenu

config REALTEK_IO_DEMO_APP
   bool
   default y

rsource "../../../Kconfig"
```

## board/evb/usb_lib/Kconfig.usb
```kconfig
if REALTEK_USB

config REALTEK_USB_TARGET_NAME
   string
   default "libusb"

endif
```

## board/evb/usb_lib/Kconfig.usb_hal
```kconfig
if REALTEK_USB_HAL

config REALTEK_USB_HAL_TARGET_NAME
   string
   default "libusb_hal"

endif
```

## src/sample/common/Kconfig
```kconfig
menuconfig REALTEK_APP_COMMON
    bool "common"
	default n
	help
	  app common feature

if REALTEK_APP_COMMON

config REALTEK_APP_CFU_TRANSFER_ENABLE
    bool "use app cfu transfer"
	default n
	help
	   compile app_cfu_transfer.c

config REALTEK_APP_COMMON_CFU_ENABLE
    bool "use app common cfu"
	default n
	help
	   compile app_common_cfu.c

config REALTEK_APP_DATA_CAPTURE_ENABLE
    bool "use app data capture"
	default n
	help
	   compile app_data_capture.c

config REALTEK_APP_DSP_CONFIG_ENABLE
    bool "use app dsp cfg"
	default n
	help
	   compile app_dsp_cfg.c

config REALTEK_APP_NREC_ENABLE
    bool "use app nrec"
	default n
	help
	   compile app_nrec.c
	   
config REALTEK_APP_SIDETONE_ENABLE
    bool "use app side tone"
	default n
	help
	   compile app_sidetone.c

endif
```
